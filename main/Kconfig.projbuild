## main/Kconfig.projbuild
```kconfig
menu "Application Configuration"

	orsource "$IDF_PATH/examples/common_components/env_caps/$IDF_TARGET/Kconfig.env_caps"

	# ------------------- MPU -------------------

	config GPIO_RANGE_MAX
		int
		default 33 if IDF_TARGET_ESP32
		default 46 if IDF_TARGET_ESP32S2
		default 48 if IDF_TARGET_ESP32S3
		default 18 if IDF_TARGET_ESP32C2
		default 19 if IDF_TARGET_ESP32C3
		default 30 if IDF_TARGET_ESP32C6

	config ESP_WIFI_SSID
		string "WiFi SSID"
		default "myssid"
		help
			SSID (network name) for the example to connect to.

	config ESP_WIFI_PASSWORD
		string "WiFi Password"
		default "mypassword"
		help
			WiFi password (WPA or WPA2) for the example to use.

	config ESP_MAXIMUM_RETRY
		int "Maximum retry"
		default 5
		help
			Set the Maximum retry to avoid station reconnecting to the AP unlimited when the AP is really inexistent.

	config GPIO_SCL
		int "SCL GPIO number"
		range 0 GPIO_RANGE_MAX
		default 22 if IDF_TARGET_ESP32
		default 12 if IDF_TARGET_ESP32S2 || IDF_TARGET_ESP32S3
		default  5 # C3 and others
		help
			GPIO number (IOxx) to I2C SCL.

	config GPIO_SDA
		int "SDA GPIO number"
		range 0 GPIO_RANGE_MAX
		default 21 if IDF_TARGET_ESP32
		default 11 if IDF_TARGET_ESP32S2 || IDF_TARGET_ESP32S3
		default  4 # C3 and others
		help
			GPIO number (IOxx) of SDA.


	# ------------------- LED Blinking -------------------

	choice BLINK_LED
		prompt "Blink LED type"
		default BLINK_LED_GPIO if IDF_TARGET_ESP32 || IDF_TARGET_ESP32C2
		default BLINK_LED_STRIP
		help
			Select the LED type. A normal level controlled LED or an addressable LED strip.
			The default selection is based on the Espressif DevKit boards.
			You can change the default selection according to your board.

		config BLINK_LED_GPIO
			bool "GPIO"
		config BLINK_LED_STRIP
			bool "LED strip"
	endchoice

	choice BLINK_LED_STRIP_BACKEND
		depends on BLINK_LED_STRIP
		prompt "LED strip backend peripheral"
		default BLINK_LED_STRIP_BACKEND_RMT if SOC_RMT_SUPPORTED
		default BLINK_LED_STRIP_BACKEND_SPI
		help
			Select the backend peripheral to drive the LED strip.

		config BLINK_LED_STRIP_BACKEND_RMT
			depends on SOC_RMT_SUPPORTED
			bool "RMT"
		config BLINK_LED_STRIP_BACKEND_SPI
			bool "SPI"
	endchoice

	config BLINK_GPIO
		int "Blink GPIO number"
		range ENV_GPIO_RANGE_MIN ENV_GPIO_OUT_RANGE_MAX
		default 5 if IDF_TARGET_ESP32
		default 18 if IDF_TARGET_ESP32S2
		default 48 if IDF_TARGET_ESP32S3
		default 8
		help
			GPIO number (IOxx) to blink on and off the LED.
			Some GPIOs are used for other purposes (flash connections, etc.) and cannot be used to blink.

	config BLINK_PERIOD
		int "Blink period in ms"
		range 10 3600000
		default 1000
		help
			Define the blinking period in milliseconds.


	# ------------------- BMP -------------------

	config EXAMPLE_I2C_MASTER_SCL
		int "SCL GPIO Number"
		default 5 if IDF_TARGET_ESP8266
		default 6 if IDF_TARGET_ESP32C3
		default 19 if IDF_TARGET_ESP32 || IDF_TARGET_ESP32S2 || IDF_TARGET_ESP32S3
		default 4 if IDF_TARGET_ESP32H2
		help
			GPIO number for I2C Master clock line.

	config EXAMPLE_I2C_MASTER_SDA
		int "SDA GPIO Number"
		default 4 if IDF_TARGET_ESP8266
		default 5 if IDF_TARGET_ESP32C3
		default 18 if IDF_TARGET_ESP32 || IDF_TARGET_ESP32S2 || IDF_TARGET_ESP32S3
		default 3 if IDF_TARGET_ESP32H2
		help
			GPIO number for I2C Master data line.

endmenu
```
